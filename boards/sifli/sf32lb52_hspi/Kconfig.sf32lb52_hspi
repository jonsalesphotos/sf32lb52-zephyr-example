## boards/sifli/sf32lb52_hspi/Kconfig.sf32lb52_hspi
```kconfig
# Copyright (c) 2025 Core Devices LLC
# SPDX-License-Identifier: Apache-2.0

config BOARD_SF32LB52_HSPI
	select SOC_SF32LB525UC6
```

## boards/sifli/sf32lb52_hspi/board.yml
```yaml
# Copyright (c) 2025 Core Devices LLC
# SPDX-License-Identifier: Apache-2.0

board:
  name: sf32lb52_hspi
  full_name: SF32LB52-HSPI (Huangshan Pi)
  vendor: sifli
  socs:
    - name: sf32lb525uc6
```

## dts/bindings/charger/awinic,aw32001.yaml
```yaml
# Copyright (c) 2026 SiFli Technologies(Nanjing) Co., Ltd
# SPDX-License-Identifier: Apache-2.0

description: |
  Awinic AW32001 single-cell linear battery charger, controlled over I2C
  (address 0x49 on the LCKFB SF32LB52-HSPI / Huangshan Pi board).

  Placeholder binding: no Zephyr driver consumes this compatible yet. It
  exists so the board devicetree can describe the charger completely; the
  node should stay disabled until a driver is available. Register-level
  reference: SiFli-SDK customer/peripherals/charger/aw32001 and
  sf32lb52-lchspi-ulp_base/bsp_power.c (CEB bit at reg 0x01 bit3, watchdog
  disable at reg 0x05 bits 5-6).

compatible: "awinic,aw32001"

include: i2c-device.yaml
```

## west.yml
```yaml
# Copyright (c) 2021 Nordic Semiconductor ASA
# SPDX-License-Identifier: Apache-2.0

manifest:
  self:
    west-commands: scripts/west-commands.yml

  remotes:
    - name: opensifli
      url-base: https://github.com/OpenSiFli
    - name: lvgl
      url-base: https://github.com/lvgl

  projects:
    - name: lvgl
      remote: lvgl
      repo-path: lvgl
      revision: 85aa60d18b3d5e5588d7b247abf90198f07c8a63
      path: modules/lib/gui/lvgl

    - name: zephyr
      remote: opensifli
      repo-path: zephyr-downstream
      revision: main
      import:
        # Keep only the modules needed for SiFli SF32LB52x targets and app features.
        name-allowlist:
          - cmsis_6    # required by the ARM Cortex-M port
          - hal_sifli  # required by SiFli SF32LB52x SoCs
          - cmsis-dsp  # optional DSP/math acceleration
          - cmsis-nn   # optional neural network kernels
          - fatfs      # optional FAT filesystem support
          - littlefs   # optional flash-friendly filesystem support
          - lvgl       # optional GUI support
          - mcuboot    # optional bootloader/OTA image support
          - nanopb     # optional protobuf serialization support
          - zcbor      # optional CBOR serialization support
```
