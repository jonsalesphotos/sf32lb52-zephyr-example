/*
 * Copyright (c) 2025 SiFli Technologies(Nanjing) Co., Ltd
 *
 * SPDX-License-Identifier: Apache-2.0
 */

/*
 * Board overlay for the UART shell sample on the SF32LB52-HSPI (Huangshan Pi).
 *
 * The board device tree already routes the Zephyr console and shell to
 * usart1, so this overlay only pins the shell UART explicitly for the sample
 * and is the place to add sample-specific tweaks (baud rate, extra UARTs, ...).
 */

/ {
	chosen {
		zephyr,console = &usart1;
		zephyr,shell-uart = &usart1;
	};
};

&usart1 {
	status = "okay";
	current-speed = <1000000>;
	pinctrl-0 = <&usart1_default>;
	pinctrl-names = "default";
};
